## eperd/Config.in
```kconfig
#
# For a description of the syntax of this configuration file,
# see scripts/kbuild/config-language.txt.
#

menu "Eperd"

config EOOQD
	bool "Eooqd"
	default n
	select FEATURE_SUID
	select FEATURE_SYSLOG
	help
	    Eooqd runs Atlas measurements just once.

config EPERD
	bool "Eperd"
	default n
	select FEATURE_SUID
	select FEATURE_SYSLOG
	help
	    Eperd periodically runs Atlas measurements. It is based on crond.

config EVHTTPGET
       bool "evhttpget"
       default n
       help
               standalone version of event-driven httpget

config EVNTP
	bool "evntp"
	default n
	help
	    	standalone version of event-driven ntp

config EVPING
	bool "evping"
	default n
	help
		standalone version of event-driven ping

config EVSSLGETCERT
	bool "evsslgetcert"
	default n
	help
		standalone version of event-driven sslgetcert

config EVTDIG
	bool "evtdig"
	default n
	depends on EPERD
	help
	   tiny dig event driven version. support only limited queries id.sever 
            txt chaos.  RIPE NCC 2011

config FEATURE_EVTDIG_DEBUG
	bool "Enable debug support in evtdig"
	default n
	depends on EVTDIG	
	help
 	 extra debug info. Also may cause segfault or/and memory leak. Add at your own risk.

config EVTRACEROUTE
	bool "evtraceroute"
	default n
	help
		standalone version of event-driven traceroute
endmenu
```

## openwrt/Config.in
```kconfig
choice
	prompt "Probe Type"
	default RIPE_ATLAS_PROBE_TYPE_GENERIC

config RIPE_ATLAS_PROBE_TYPE_GENERIC
	bool "Generic"
	help
	  Generic software probe.

config RIPE_ATLAS_PROBE_TYPE_V3
	bool "HWProbe V3"
	help
	  Hardware Probe V3.

config RIPE_ATLAS_PROBE_TYPE_V4
	bool "HWProbe V4"
	help
	  Hardware Probe V4.

config RIPE_ATLAS_PROBE_TYPE_V5
	bool "HWProbe V5"
	help
	  Hardware Probe V5.
endchoice
```
